## Kconfig
```kconfig
#! @file Kconfig
 #* @brief Kconfig configuration file
 #
 # @author A BLUE THING IN THE CLOUD S.L.U.
 #    ===  When the technology becomes art ===
 #
 # http://abluethinginthecloud.com
 # j.longares@abluethinginthecloud
 #
 # (c) A BLUE THING IN THE CLOUD S.L.U.
 #
 #
 #
 #       ██████████████    ██    ██    ██  ██████    ██████████████
 #       ██          ██      ████████████████  ██    ██          ██
 #       ██  ██████  ██  ██████  ██    ██        ██  ██  ██████  ██
 #       ██  ██████  ██    ██████    ██      ██      ██  ██████  ██
 #       ██  ██████  ██      ██      ████  ██████    ██  ██████  ██
 #       ██          ██    ██      ██████    ████    ██          ██
 #       ██████████████  ██  ██  ██  ██  ██  ██  ██  ██████████████
 #                       ██████  ████  ██████  ████
 #       ██████  ██████████  ████    ████████      ████      ██
 #       ██  ████  ██    ██  ████        ████    ████████  ██    ██
 #           ██  ██  ████  ██      ██      ██      ██  ████  ██████
 #       ████  ████    ██      ██          ████  ██  ██        ██
 #           ██████████          ██      ██    ██  ████    ██  ████
 #         ██  ████    ██      ██████    ██  ██████████    ██    ██
 #       ██  ████  ████████████████  ██    ██        ████████  ████
 #               ████        ██  ██████  ██████████      ████  ██
 #       ██████  ████████████████    ████  ██    ██████    ██  ████
 #           ████████  ██████  ██    ██████      ██        ████  ██
 #       ██    ██  ████████  ██    ██        ██    ██          ████
 #         ████  ████          ██      ████████████  ██  ████  ██
 #       ██  ██████  ████  ██    ██      ████    ██████████
 #                       ██    ██████    ██      ██      ██  ██████
 #       ██████████████  ██  ██████  ██  ████  ████  ██  ████  ████
 #       ██          ██  ██      ████████  ██    ██      ████  ████
 #       ██  ██████  ██  ████  ██    ██████      ██████████    ████
 #       ██  ██████  ██    ██████    ██  ██  ████      ████  ██████
 #       ██  ██████  ██  ████      ██    ████  ██        ████    ██
 #       ██          ██  ██    ██      ██████████████  ██      ██
 #       ██████████████  ██████  ██        ██  ████    ██████  ████
 # 


menu "MQTT sample"

config MQTT_SAMPLE_PAYLOAD_CHANNEL_STRING_MAX_SIZE
	int "Payload maximum string size"
	default 100
	help
	  Maximum size of the string included messages that are sent over the payload channel.

rsource "src/modules/trigger/Kconfig.trigger"
rsource "src/modules/sampler/Kconfig.sampler"
rsource "src/modules/network/Kconfig.network"
rsource "src/modules/transport/Kconfig.transport"
rsource "src/modules/error/Kconfig.error"
rsource "src/modules/led/Kconfig.led"

config MQTT_HELPER_CUSTOM
	bool "Enable my function"
	default n
endmenu

menu "Zephyr Kernel"
source "Kconfig.zephyr"
endmenu
```

## src/modules/network/Kconfig.network
```kconfig
#
# Copyright (c) 2023 Nordic Semiconductor
#
# SPDX-License-Identifier: LicenseRef-Nordic-5-Clause
#

menu "Network"
	depends on LTE_LINK_CONTROL || (WIFI_NRF700X && WIFI_MGMT_EXT) || BOARD_NATIVE_POSIX

config MQTT_SAMPLE_NETWORK_THREAD_STACK_SIZE
	int "Thread stack size"
	default 4096

choice  STA_KEY_MGMT_SELECT
	prompt "Security Option"
	default STA_KEY_MGMT_WPA3

config STA_KEY_MGMT_NONE
	bool "Open Security"
	help
	  Enable for Open Security

config STA_KEY_MGMT_WPA2
	bool "WPA2 Security"
	help
	  Enable for WPA2 Security

config STA_KEY_MGMT_WPA2_256
	bool "WPA2 SHA 256 Security"
	help
	  Enable for WPA2-PSK-256 Security

config STA_KEY_MGMT_WPA3
	bool "WPA3 Security"
	help
	  Enable for WPA3 Security
endchoice
module = MQTT_SAMPLE_NETWORK
module-str = Network
source "subsys/logging/Kconfig.template.log_config"

endmenu # Network
```

## src/modules/transport/Kconfig.transport
```kconfig
#! @file Kconfig
 #* @brief Kconfig configuration file
 #
 # @author A BLUE THING IN THE CLOUD S.L.U.
 #    ===  When the technology becomes art ===
 #
 # http://abluethinginthecloud.com
 # j.longares@abluethinginthecloud
 #
 # (c) A BLUE THING IN THE CLOUD S.L.U.
 #
 #
 #
 #       ██████████████    ██    ██    ██  ██████    ██████████████
 #       ██          ██      ████████████████  ██    ██          ██
 #       ██  ██████  ██  ██████  ██    ██        ██  ██  ██████  ██
 #       ██  ██████  ██    ██████    ██      ██      ██  ██████  ██
 #       ██  ██████  ██      ██      ████  ██████    ██  ██████  ██
 #       ██          ██    ██      ██████    ████    ██          ██
 #       ██████████████  ██  ██  ██  ██  ██  ██  ██  ██████████████
 #                       ██████  ████  ██████  ████
 #       ██████  ██████████  ████    ████████      ████      ██
 #       ██  ████  ██    ██  ████        ████    ████████  ██    ██
 #           ██  ██  ████  ██      ██      ██      ██  ████  ██████
 #       ████  ████    ██      ██          ████  ██  ██        ██
 #           ██████████          ██      ██    ██  ████    ██  ████
 #         ██  ████    ██      ██████    ██  ██████████    ██    ██
 #       ██  ████  ████████████████  ██    ██        ████████  ████
 #               ████        ██  ██████  ██████████      ████  ██
 #       ██████  ████████████████    ████  ██    ██████    ██  ████
 #           ████████  ██████  ██    ██████      ██        ████  ██
 #       ██    ██  ████████  ██    ██        ██    ██          ████
 #         ████  ████          ██      ████████████  ██  ████  ██
 #       ██  ██████  ████  ██    ██      ████    ██████████
 #                       ██    ██████    ██      ██      ██  ██████
 #       ██████████████  ██  ██████  ██  ████  ████  ██  ████  ████
 #       ██          ██  ██      ████████  ██    ██      ████  ████
 #       ██  ██████  ██  ████  ██    ██████      ██████████    ████
 #       ██  ██████  ██    ██████    ██  ██  ████      ████  ██████
 #       ██  ██████  ██  ████      ██    ████  ██        ████    ██
 #       ██          ██  ██    ██      ██████████████  ██      ██
 #       ██████████████  ██████  ██        ██  ████    ██████  ████
 # 


menu "Transport"
	depends on MQTT_HELPER
	depends on HW_ID_LIBRARY

config MQTT_SAMPLE_TRANSPORT_RECONNECTION_TIMEOUT_SECONDS
	int "Reconnection timeout in seconds"
	default 60
	help
	  Time in between reconnection attempts to the MQTT broker.

config MQTT_SAMPLE_TRANSPORT_THREAD_STACK_SIZE
	int "Thread stack size"
	default 2048

config MQTT_SAMPLE_TRANSPORT_MESSAGE_QUEUE_SIZE
	int "Message queue size"
	default 5
	help
	  ZBus subscriber message queue size.

config MQTT_SAMPLE_TRANSPORT_WORKQUEUE_STACK_SIZE
	int "Workqueue stack size"
	default 4096
	help
	  Stack size of the module's internal workqueue.

config MQTT_SAMPLE_TRANSPORT_BROKER_HOSTNAME
	string "MQTT broker hostname"
	default "test.mosquitto.org"

config MQTT_SAMPLE_TRANSPORT_CLIENT_ID
	string "MQTT Client ID"
	default ""
	help
	  Use a custom client ID string. If not set, the client ID will default to the
	  modem's IMEI number for nRF9160 boards, MAC address for the nRF7002 DK,
	  or a random number for Native Posix.

config MQTT_SAMPLE_TRANSPORT_CLIENT_ID_BUFFER_SIZE
	int "MQTT Client ID buffer size"
	default 50
	help
	  Size of buffer used to store the MQTT client ID.

config MQTT_SAMPLE_TRANSPORT_PUBLISH_TOPIC
	string "MQTT publish topic"
	default "my/publish/topic"

config MQTT_SAMPLE_TRANSPORT_SUBSCRIBE_TOPIC
	string "MQTT subscribe topic"
	default "my/subscribe/topic"

config MQTT_SAMPLE_TRANSPORT_BROKER_USERNAME
	string "MQTT username"
	default "noUser"

config MQTT_SAMPLE_TRANSPORT_BROKER_PASSWORD
	string "MQTT password"
	default "noPassword"

config MQTT_SAMPLE_TRANSPORT_MESSAGE
	string "MQTT message"
	default "message"

module = MQTT_SAMPLE_TRANSPORT
module-str = Transport
source "subsys/logging/Kconfig.template.log_config"


endmenu # Transport
```
